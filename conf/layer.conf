## conf/layer.conf
```bitbake
# 
# We have a conf and classes directory, add to BBPATH
BBPATH .= ":${LAYERDIR}"

# We have recipes-* directories, add to BBFILES
BBFILES += "${LAYERDIR}/recipes-*/*/*.bb \
            ${LAYERDIR}/recipes-*/*/*.bbappend"

BBFILE_COLLECTIONS += "meta-myexamples-git"
BBFILE_PATTERN_meta-myexamples-git = "^${LAYERDIR}/"
BBFILE_PRIORITY_meta-myexamples-git = "6"

LAYERDEPENDS_meta-myexamples-git = "core"
LAYERSERIES_COMPAT_meta-myexamples-git = "styhead"
```
